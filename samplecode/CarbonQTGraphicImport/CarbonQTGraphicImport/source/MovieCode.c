/*
	File:		MovieCode.c
	
	Description:Code for calling QuickTime's Movie Toolbox to show and work with movie files.

	Author:		MC

	Copyright: 	© Copyright 1999-2000 Apple Computer, Inc. All rights reserved.
	
	Disclaimer:	IMPORTANT:  This Apple software is supplied to you by Apple Computer, Inc.
				("Apple") in consideration of your agreement to the following terms, and your
				use, installation, modification or redistribution of this Apple software
				constitutes acceptance of these terms.  If you do not agree with these terms,
				please do not use, install, modify or redistribute this Apple software.

				In consideration of your agreement to abide by the following terms, and subject
				to these terms, Apple grants you a personal, non-exclusive license, under AppleÕs
				copyrights in this original Apple software (the "Apple Software"), to use,
				reproduce, modify and redistribute the Apple Software, with or without
				modifications, in source and/or binary forms; provided that if you redistribute
				the Apple Software in its entirety and without modifications, you must retain
				this notice and the following text and disclaimers in all such redistributions of
				the Apple Software.  Neither the name, trademarks, service marks or logos of
				Apple Computer, Inc. may be used to endorse or promote products derived from the
				Apple Software without specific prior written permission from Apple.  Except as
				expressly stated in this notice, no other rights or licenses, express or implied,
				are granted by Apple herein, including but not limited to any patent rights that
				may be infringed by your derivative works or by other works in which the Apple
				Software may be incorporated.

				The Apple Software is provided by Apple on an "AS IS" basis.  APPLE MAKES NO
				WARRANTIES, EXPRESS OR IMPLIED, INCLUDING WITHOUT LIMITATION THE IMPLIED
				WARRANTIES OF NON-INFRINGEMENT, MERCHANTABILITY AND FITNESS FOR A PARTICULAR
				PURPOSE, REGARDING THE APPLE SOFTWARE OR ITS USE AND OPERATION ALONE OR IN
				COMBINATION WITH YOUR PRODUCTS.

				IN NO EVENT SHALL APPLE BE LIABLE FOR ANY SPECIAL, INDIRECT, INCIDENTAL OR
				CONSEQUENTIAL DAMAGES (INCLUDING, BUT NOT LIMITED TO, PROCUREMENT OF SUBSTITUTE
				GOODS OR SERVICES; LOSS OF USE, DATA, OR PROFITS; OR BUSINESS INTERRUPTION)
				ARISING IN ANY WAY OUT OF THE USE, REPRODUCTION, MODIFICATION AND/OR DISTRIBUTION
				OF THE APPLE SOFTWARE, HOWEVER CAUSED AND WHETHER UNDER THEORY OF CONTRACT, TORT
				(INCLUDING NEGLIGENCE), STRICT LIABILITY OR OTHERWISE, EVEN IF APPLE HAS BEEN
				ADVISED OF THE POSSIBILITY OF SUCH DAMAGE.
				
	Change History (most recent first):

*/

#define TARGET_API_MAC_CARBON 1

#include <Movies.h>

#include "Structs.h"
#include "Defines.h"
#include "WindowCode.h"
#include "MovieCode.h"

OSErr	DrawMovie (FSSpec *theSpec, WindowPtr theWindow, TimeValue time) {
	ComponentResult				err;
	WindowInfoHandle			winInfo;
	Rect						movieBox,
								totalBox;
	short						resRefNum,
								resID;
	SInt8						handleState;

	if (theWindow != nil) {
		winInfo = (WindowInfoHandle)GetWRefCon (theWindow);
	}

	if (winInfo != nil && (**winInfo).sig == kMySig) {
		handleState = HGetState ((Handle)winInfo);
		HLock ((Handle)winInfo);

		SetPort (GetWindowPort(theWindow));

		err = OpenMovieFile (theSpec, &resRefNum, fsRdPerm);

		if (err == noErr) {
			err = NewMovieFromFile (&((**winInfo).winMovie), resRefNum, &resID, nil, newMovieActive, nil);
		}

		if (err == noErr) {
			err = CloseMovieFile (resRefNum);	// Don't need to keep the movie open just to play it
		}

		if (err == noErr) {
			SetMovieGWorld ((**winInfo).winMovie, GetWindowPort(theWindow), nil);
			GetMovieBox ((**winInfo).winMovie, &movieBox);
			// Move the movie to 0,0 inside its window.
			movieBox.bottom = (short)(movieBox.bottom - movieBox.top);
			movieBox.top = 0;
			movieBox.right = (short)(movieBox.right - movieBox.left);
			movieBox.left = 0;
			(**winInfo).winMovieController = NewMovieController ((**winInfo).winMovie, &movieBox, mcTopLeftMovie | mcNotVisible);
		}

		if ((**winInfo).winMovieController == nil) {
			err = memFullErr;
		}

		if (err == noErr) {
			err = MCGetControllerBoundsRect ((**winInfo).winMovieController, &totalBox);
		}

		if (err == noErr) {
			if (time == 0) {
				GoToBeginningOfMovie ((**winInfo).winMovie);
			} else {
				SetMovieTimeValue ((**winInfo).winMovie, time);
			}
			MCSetVisible ((**winInfo).winMovieController, true);
			SizeWindow (theWindow, (short)(totalBox.right - totalBox.left), (short)(totalBox.bottom - totalBox.top), true);
			ShowWindow (theWindow);
		}

		HSetState ((Handle)winInfo, handleState);
	}

	return (OSErr)err;
}

OSErr	NewWindowWithMovie (FSSpec *theSpec, WindowPtr behindWindow) {
	WindowPtr					theWindow;
	WindowInfoHandle			winInfo;
	OSErr						err;

	err = MakeNewWindow (theSpec->name, false, behindWindow, &theWindow);

	if (err == noErr) {
		if (theWindow != nil) {
			winInfo = (WindowInfoHandle)GetWRefCon (theWindow);
		}

		if (winInfo != nil && (**winInfo).sig == kMySig) {
			(**winInfo).winType = kMovieWinType;
			BlockMoveData (theSpec, &((**winInfo).winSpec), sizeof (FSSpec));
		} else {
			err = paramErr;
		}
	}

	if (err == noErr) {
		CursHandle		cursor = nil;

		cursor = GetCursor (watchCursor);
		SetCursor (*cursor);
		err = DrawMovie (&((**winInfo).winSpec), theWindow, 0);

		if (err == noErr) {
			ObscureCursor ();
		} else {
			CloseThisWindow (theWindow);
		}

		cursor = (CursHandle)NewHandle (sizeof (Cursor));
		GetQDGlobalsArrow (*cursor);
		SetCursor (*cursor);
		DisposeHandle ((Handle)cursor);
	}

	return err;
}

OSErr	UpdateMovieWindow (WindowPtr theWindow) {
	OSErr						err;
	WindowInfoHandle			winInfo;
	SInt8						handleState;						

	if (theWindow != nil) {
		winInfo = (WindowInfoHandle)GetWRefCon (theWindow);
	}

	if (winInfo != nil && (**winInfo).sig == kMySig) {
		handleState = HGetState ((Handle)winInfo);
		HLock ((Handle)winInfo);

		SetPort (GetWindowPort(theWindow));

		if ((**winInfo).winMovie != nil) {
			if ((**winInfo).winMovieController != nil) {
				MCDraw ((**winInfo).winMovieController, theWindow);
			}
			err = UpdateMovie ((**winInfo).winMovie);
			MoviesTask (DoTheRightThing, DoTheRightThing);
		} else if ((**winInfo).winSpec.vRefNum != 0) {
			err = DrawMovie (&((**winInfo).winSpec), theWindow, (**winInfo).winMovieTime);
			if (theWindow != FrontWindow ()) {
				MCActivate ((**winInfo).winMovieController, theWindow, false);
			}
		}

		HSetState ((Handle)winInfo, handleState);
	}

	return err;
}

