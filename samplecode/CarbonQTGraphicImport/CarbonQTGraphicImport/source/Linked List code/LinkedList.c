/*
	File:		LinkedList.c
	
	Description:Generic linked list code.

	Author:		MC

	Copyright: 	© Copyright 1999-2000 Apple Computer, Inc. All rights reserved.
	
	Disclaimer:	IMPORTANT:  This Apple software is supplied to you by Apple Computer, Inc.
				("Apple") in consideration of your agreement to the following terms, and your
				use, installation, modification or redistribution of this Apple software
				constitutes acceptance of these terms.  If you do not agree with these terms,
				please do not use, install, modify or redistribute this Apple software.

				In consideration of your agreement to abide by the following terms, and subject
				to these terms, Apple grants you a personal, non-exclusive license, under AppleÕs
				copyrights in this original Apple software (the "Apple Software"), to use,
				reproduce, modify and redistribute the Apple Software, with or without
				modifications, in source and/or binary forms; provided that if you redistribute
				the Apple Software in its entirety and without modifications, you must retain
				this notice and the following text and disclaimers in all such redistributions of
				the Apple Software.  Neither the name, trademarks, service marks or logos of
				Apple Computer, Inc. may be used to endorse or promote products derived from the
				Apple Software without specific prior written permission from Apple.  Except as
				expressly stated in this notice, no other rights or licenses, express or implied,
				are granted by Apple herein, including but not limited to any patent rights that
				may be infringed by your derivative works or by other works in which the Apple
				Software may be incorporated.

				The Apple Software is provided by Apple on an "AS IS" basis.  APPLE MAKES NO
				WARRANTIES, EXPRESS OR IMPLIED, INCLUDING WITHOUT LIMITATION THE IMPLIED
				WARRANTIES OF NON-INFRINGEMENT, MERCHANTABILITY AND FITNESS FOR A PARTICULAR
				PURPOSE, REGARDING THE APPLE SOFTWARE OR ITS USE AND OPERATION ALONE OR IN
				COMBINATION WITH YOUR PRODUCTS.

				IN NO EVENT SHALL APPLE BE LIABLE FOR ANY SPECIAL, INDIRECT, INCIDENTAL OR
				CONSEQUENTIAL DAMAGES (INCLUDING, BUT NOT LIMITED TO, PROCUREMENT OF SUBSTITUTE
				GOODS OR SERVICES; LOSS OF USE, DATA, OR PROFITS; OR BUSINESS INTERRUPTION)
				ARISING IN ANY WAY OUT OF THE USE, REPRODUCTION, MODIFICATION AND/OR DISTRIBUTION
				OF THE APPLE SOFTWARE, HOWEVER CAUSED AND WHETHER UNDER THEORY OF CONTRACT, TORT
				(INCLUDING NEGLIGENCE), STRICT LIABILITY OR OTHERWISE, EVEN IF APPLE HAS BEEN
				ADVISED OF THE POSSIBILITY OF SUCH DAMAGE.
				
	Change History (most recent first):

*/

#define TARGET_API_MAC_CARBON 1

#include "LinkedList.h"

myListPtr NewList (OSErr *err) {
	myListPtr			theNewList;

	theNewList = (myListPtr)NewPtrClear (sizeof (myList));
	*err = MemError ();

	return (theNewList);
}

OSErr AppendToList (void *itemToInsert, myListPtr *listToUse) {
	myListPtr			temp,
						prev,
						newNode;
	OSErr				err;

	if (*listToUse != nil) {
		temp = (*listToUse)->next;
		prev = *listToUse;

		while (temp != nil) {
			prev = temp;
			temp = temp->next;
		}

		newNode = (myListPtr)NewPtr (sizeof (myList));

		err = MemError ();

		if (newNode != nil) {
			newNode->data = itemToInsert;
			newNode->next = nil;
			prev->next = newNode;
		}
	} else {
		*listToUse = NewList (&err);
		(*listToUse)->data = itemToInsert;
	}

	return err;
}

void* GetItemNumFromList (unsigned long num, myListPtr listToUse) {
	myListPtr			temp;
	unsigned long		i;

	temp = listToUse;
	if (temp != nil) {
		for (i = 0; i < num; i++) {
			if (temp->next != nil) {
				temp = temp->next;
			} else {
				return nil;
			}
		}
		return temp->data;
	} else {
		return nil;
	}
}

OSErr DeleteHeadFromList (myListPtr *listToUse) {
	myListPtr			temp;
	OSErr				err;

	temp = *listToUse;
	err = qErr;

	if (temp != nil) {
		*listToUse = temp->next;
		if (temp->data != nil) {
			DisposePtr ((Ptr)temp->data);
		}
		DisposePtr ((Ptr)temp);
		err = noErr;
	}

	return err;
}

OSErr DeleteItemNumFromList (unsigned long num, myListPtr *listToUse) {
	myListPtr			temp,
						prev;
	OSErr				err;
	unsigned long		i;

	temp = *listToUse;
	prev = (myListPtr)listToUse;
	err = qErr;

	if (temp != nil) {
		for (i = 0; i < num; i++) {
			if (temp->next != nil) {
				prev = temp;
				temp = temp->next;
			} else {
				return err;
			}
		}
		prev->next = temp->next;
		if (temp->data != nil) {
			DisposePtr ((Ptr)temp->data);
			temp->data = nil;
		}
		DisposePtr ((Ptr)temp);
		err = noErr;
	}

	return err;
}

