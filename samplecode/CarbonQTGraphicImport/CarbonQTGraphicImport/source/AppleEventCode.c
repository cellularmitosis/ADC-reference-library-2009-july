/*
	File:		AppleEventCode.c
	
	Description:Code that handles the basic System 7 Apple Events, run, open, print, quit.

	Author:		MC

	Copyright: 	© Copyright 1999-2000 Apple Computer, Inc. All rights reserved.
	
	Disclaimer:	IMPORTANT:  This Apple software is supplied to you by Apple Computer, Inc.
				("Apple") in consideration of your agreement to the following terms, and your
				use, installation, modification or redistribution of this Apple software
				constitutes acceptance of these terms.  If you do not agree with these terms,
				please do not use, install, modify or redistribute this Apple software.

				In consideration of your agreement to abide by the following terms, and subject
				to these terms, Apple grants you a personal, non-exclusive license, under AppleÕs
				copyrights in this original Apple software (the "Apple Software"), to use,
				reproduce, modify and redistribute the Apple Software, with or without
				modifications, in source and/or binary forms; provided that if you redistribute
				the Apple Software in its entirety and without modifications, you must retain
				this notice and the following text and disclaimers in all such redistributions of
				the Apple Software.  Neither the name, trademarks, service marks or logos of
				Apple Computer, Inc. may be used to endorse or promote products derived from the
				Apple Software without specific prior written permission from Apple.  Except as
				expressly stated in this notice, no other rights or licenses, express or implied,
				are granted by Apple herein, including but not limited to any patent rights that
				may be infringed by your derivative works or by other works in which the Apple
				Software may be incorporated.

				The Apple Software is provided by Apple on an "AS IS" basis.  APPLE MAKES NO
				WARRANTIES, EXPRESS OR IMPLIED, INCLUDING WITHOUT LIMITATION THE IMPLIED
				WARRANTIES OF NON-INFRINGEMENT, MERCHANTABILITY AND FITNESS FOR A PARTICULAR
				PURPOSE, REGARDING THE APPLE SOFTWARE OR ITS USE AND OPERATION ALONE OR IN
				COMBINATION WITH YOUR PRODUCTS.

				IN NO EVENT SHALL APPLE BE LIABLE FOR ANY SPECIAL, INDIRECT, INCIDENTAL OR
				CONSEQUENTIAL DAMAGES (INCLUDING, BUT NOT LIMITED TO, PROCUREMENT OF SUBSTITUTE
				GOODS OR SERVICES; LOSS OF USE, DATA, OR PROFITS; OR BUSINESS INTERRUPTION)
				ARISING IN ANY WAY OUT OF THE USE, REPRODUCTION, MODIFICATION AND/OR DISTRIBUTION
				OF THE APPLE SOFTWARE, HOWEVER CAUSED AND WHETHER UNDER THEORY OF CONTRACT, TORT
				(INCLUDING NEGLIGENCE), STRICT LIABILITY OR OTHERWISE, EVEN IF APPLE HAS BEEN
				ADVISED OF THE POSSIBILITY OF SUCH DAMAGE.
				
	Change History (most recent first):

*/

#define TARGET_API_MAC_CARBON 1

#include "AppleEventCode.h"
#include "DisplayErrorAlert.h"
#include "GraphicImportDrawCode.h"
#include "WindowCode.h"
#include "LinkedList.h"
#include "MyCarbonPrinting.h"

#include "Structs.h"
#include "Defines.h"

extern	Boolean						gDone;
extern	myListPtr					gFilesToOpen;
extern	PreferencesHandle			gPreferences;

OSErr InstallRequiredAppleEvents (void) {
	OSErr					err;

	err = AEInstallEventHandler (kCoreEventClass, kAEOpenApplication, NewAEEventHandlerProc (HandleOApp), 0, false);

	if (err == noErr)
		err = AEInstallEventHandler (kCoreEventClass, kAEOpenDocuments, NewAEEventHandlerProc (HandleODoc), 0, false);

	if (err == noErr)
		err = AEInstallEventHandler (kCoreEventClass, kAEPrintDocuments, NewAEEventHandlerProc (HandlePDoc), 0, false);

	if (err == noErr)
		err = AEInstallEventHandler (kCoreEventClass, kAEQuitApplication, NewAEEventHandlerProc (HandleQuit), 0, false);

	return err;
}

pascal OSErr HandleOApp (const AppleEvent *theAppleEvent, AppleEvent *reply, unsigned long handlerRefcon) {
#pragma unused (theAppleEvent, reply, handlerRefcon)

	return noErr;				/* We're up and running */
}

pascal OSErr HandleODoc (const AppleEvent *theAppleEvent, AppleEvent *reply, unsigned long handlerRefcon) {
#pragma unused (reply, handlerRefcon)
	AEDescList			docList;
	OSErr				err;
	long				i,
						itemsInList,
						direction;
	Size				actualSize;
	AEKeyword			keywd;
	DescType			returnedType;

	err = AEGetParamDesc (theAppleEvent, keyDirectObject, typeAEList, &docList);
	if (err == noErr) {
		err = AECountItems (&docList, &itemsInList);
	}

	if (err == noErr) {
		FSSpecPtr	fileSpecPtr;

		if ((**gPreferences).openInReverseOrder == false) {
			i = 1;
			direction = 1;
		} else {
			i = itemsInList;
			direction = -1;
		}

		do {
			fileSpecPtr = (FSSpecPtr)NewPtr (sizeof (FSSpec));
			err = MemError ();

			if (err == noErr) {
				err = AEGetNthPtr (&docList, i, typeFSS, &keywd, &returnedType, fileSpecPtr, sizeof (FSSpec), &actualSize);
			}

			if (err == noErr) {
				HParamBlockRec		pb;

				pb.fileParam.ioCompletion = nil;
				pb.fileParam.ioNamePtr = fileSpecPtr->name;
				pb.fileParam.ioVRefNum = fileSpecPtr->vRefNum;
				pb.fileParam.ioDirID = fileSpecPtr->parID;
				pb.fileParam.ioFDirIndex = 0;

				err = PBHGetFInfoSync (&pb);
				if (err == noErr && pb.fileParam.ioFlFndrInfo.fdType != 'pref') {
					err = AppendToList (fileSpecPtr, &gFilesToOpen);
				}
			}

			i += direction;
		} while (err == noErr);

		// The last time through the loop we allocate a pointer we don't need.
		DisposePtr ((Ptr)fileSpecPtr);
	}

	(void)AEDisposeDesc (&docList);

	return err;
}

pascal OSErr HandlePDoc (const AppleEvent *theAppleEvent, AppleEvent *reply, unsigned long handlerRefcon) {
#pragma unused (reply, handlerRefcon)
	AEDescList					docList;
	OSErr						err;
	long						i,
								itemsInList,
								direction;
	Size						actualSize;
	AEKeyword					keywd;
	DescType					returnedType;

	err = AEGetParamDesc (theAppleEvent, keyDirectObject, typeAEList, &docList);
	if (err == noErr) {
		err = AECountItems (&docList, &itemsInList);
	}

	if (err == noErr) {
		FSSpecPtr	fileSpecPtr;

		if ((**gPreferences).openInReverseOrder == false) {
			i = 1;
			direction = 1;
		} else {
			i = itemsInList;
			direction = -1;
		}

		do {
			fileSpecPtr = (FSSpecPtr)NewPtr (sizeof (FSSpec));
			err = MemError ();

			if (err == noErr) {
				err = AEGetNthPtr (&docList, i, typeFSS, &keywd, &returnedType, fileSpecPtr, sizeof (FSSpec), &actualSize);
			}

			if (err == noErr) {
				HParamBlockRec		pb;

				pb.fileParam.ioCompletion = nil;
				pb.fileParam.ioNamePtr = fileSpecPtr->name;
				pb.fileParam.ioVRefNum = fileSpecPtr->vRefNum;
				pb.fileParam.ioDirID = fileSpecPtr->parID;
				pb.fileParam.ioFDirIndex = 0;

				err = PBHGetFInfoSync (&pb);
				if (err == noErr && pb.fileParam.ioFlFndrInfo.fdType != 'pref') {
					err = NewWindowWithPict (fileSpecPtr, (WindowPtr)-1L);

					if (err == noErr) {
						err = HandlePrint (FrontWindow ());
					}

					CloseThisWindow (FrontWindow ());
				}
			} else {
				DisposePtr ((Ptr)fileSpecPtr);
			}

			i += direction;
		} while (err == noErr);
	}

	(void)AEDisposeDesc (&docList);

	return err;
}

pascal OSErr HandleQuit (const AppleEvent *theAppleEvent, AppleEvent *reply, unsigned long handlerRefcon) {
#pragma unused (theAppleEvent, reply, handlerRefcon)

	gDone = true;
	return noErr;
}

