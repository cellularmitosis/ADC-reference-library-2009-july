/*
	File:		InterruptSafeDebug.c

	Contains:	Library for logging directly to the screen.

	Written by:	Quinn "The Eskimo!"

	Copyright:	© 1998-2000 by Apple Computer, Inc., all rights reserved.

	Disclaimer:	IMPORTANT:  This Apple software is supplied to you by Apple Computer, Inc.
				("Apple") in consideration of your agreement to the following terms, and your
				use, installation, modification or redistribution of this Apple software
				constitutes acceptance of these terms.  If you do not agree with these terms,
				please do not use, install, modify or redistribute this Apple software.

				In consideration of your agreement to abide by the following terms, and subject
				to these terms, Apple grants you a personal, non-exclusive license, under AppleÕs
				copyrights in this original Apple software (the "Apple Software"), to use,
				reproduce, modify and redistribute the Apple Software, with or without
				modifications, in source and/or binary forms; provided that if you redistribute
				the Apple Software in its entirety and without modifications, you must retain
				this notice and the following text and disclaimers in all such redistributions of
				the Apple Software.  Neither the name, trademarks, service marks or logos of
				Apple Computer, Inc. may be used to endorse or promote products derived from the
				Apple Software without specific prior written permission from Apple.  Except as
				expressly stated in this notice, no other rights or licenses, express or implied,
				are granted by Apple herein, including but not limited to any patent rights that
				may be infringed by your derivative works or by other works in which the Apple
				Software may be incorporated.

				The Apple Software is provided by Apple on an "AS IS" basis.  APPLE MAKES NO
				WARRANTIES, EXPRESS OR IMPLIED, INCLUDING WITHOUT LIMITATION THE IMPLIED
				WARRANTIES OF NON-INFRINGEMENT, MERCHANTABILITY AND FITNESS FOR A PARTICULAR
				PURPOSE, REGARDING THE APPLE SOFTWARE OR ITS USE AND OPERATION ALONE OR IN
				COMBINATION WITH YOUR PRODUCTS.

				IN NO EVENT SHALL APPLE BE LIABLE FOR ANY SPECIAL, INDIRECT, INCIDENTAL OR
				CONSEQUENTIAL DAMAGES (INCLUDING, BUT NOT LIMITED TO, PROCUREMENT OF SUBSTITUTE
				GOODS OR SERVICES; LOSS OF USE, DATA, OR PROFITS; OR BUSINESS INTERRUPTION)
				ARISING IN ANY WAY OUT OF THE USE, REPRODUCTION, MODIFICATION AND/OR DISTRIBUTION
				OF THE APPLE SOFTWARE, HOWEVER CAUSED AND WHETHER UNDER THEORY OF CONTRACT, TORT
				(INCLUDING NEGLIGENCE), STRICT LIABILITY OR OTHERWISE, EVEN IF APPLE HAS BEEN
				ADVISED OF THE POSSIBILITY OF SUCH DAMAGE.

	Change History (most recent first):

$Log: InterruptSafeDebug.c,v $
Revision 1.7  2003/07/18 15:09:34         
To get around common linking problems, we now require colour QD unless you set MORE_DEBUG_SUPPORT_BW.

Revision 1.6  2002/11/08 23:21:59         
Include our prototype early to flush out any missing dependencies. Convert MoreAssertQ to assert.

Revision 1.5  2001/11/07 15:49:58         
Tidy up headers, add CVS logs, update copyright.


         <4>     24/9/01    Quinn   Fixes to compile with C++ activated.
         <3>     21/9/01    Quinn   Changes for CWPro7 Mach-O build.
         <2>    24/11/00    Quinn   Carbonise.
         <1>    23/11/98    Quinn   First checked in.
*/

/////////////////////////////////////////////////////////////////////

// Our prototypes

#include "InterruptSafeDebug.h"

// Standard Mac OS interfaces

#if ! MORE_FRAMEWORK_INCLUDES
	#include <DriverSynchronization.h>
	#include <QuickDraw.h>
	#include <QDOffscreen.h>
	#include <OpenTransport.h>
	#include <CodeFragments.h>
	#include <Gestalt.h>
#endif

// MIB prototypes

#include "MoreQuickDraw.h"

/////////////////////////////////////////////////////////////////////

// This font data was generated by the GenerateFont program, the
// source of which is included in the sample.  Each row contains
// 256 bytes, one for each character in the font.  The rows represent
// the scanline in the character.

static UInt8 gFont[10][256] = {
	{ 0x00, 0x00, 0x00, 0x00, 0x00, 0x00, 0x3c, 0x3c, 0x3c, 0x00, 0x3c, 0x3c, 0x3c,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 0x3c, 0x3c},
	{ 0x00, 0x00, 0x00, 0x00, 0x00, 0x00, 0x24, 0x24, 0x24, 0x00, 0x24, 0x24, 0x24,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 0x24, 0x24},
	{ 0x00, 0x00, 0x00, 0x00, 0x00, 0x00, 0x24, 0x24, 0x24, 0x00, 0x24, 0x24, 0x24,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 0x24, 0x24},
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	{ 0x00, 0x00, 0x00, 0x00, 0x00, 0x00, 0x00, 0x00, 0x00, 0x00, 0x00, 0x00, 0x00,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 0x00, 0x00}
};

static UInt8 *gScreenBase;
	// The base of the main screen buffer.
	
static ByteCount gRowBytes;
	// The rowbytes for the main screen buffer.

static UInt16 gBytesPerChar;
	// The number of bytes in a scanline that each character consumes.
	// This is equivalent to the bit depth.  For example, in B&W mode,
	// this is 1 (8 pixels across, at 1 bit per pixel), and in 8 bit mode
	// this is 8 (8 pixels across, at 8 bits per pixel).

static ByteCount gCurrentCharIndex;
	// The index of the next slot where a character will be
	// plotted on the screen.  This is always manipulated by
	// atomic routines, which guarantees interrupt safety.
	// It wraps around freely, so must be MODed by kISDebugMaxCharIndex
	// to get the actual placement.

/////////////////////////////////////////////////////////////////////

#if TARGET_CPU_PPC && TARGET_RT_MAC_CFM

	#ifdef __cplusplus
		extern "C" {
	#endif

		extern UInt32 AddAtomicForNonDSL(UInt32 amount, UInt32 *value);
			// This routine is used only if DriverServicesLib is not
			// available.  Because it's defined in a PPC assembly 
			// language file, it's only available if you're building 
			// CFM, but that's OK because if you're building Mach-O 
			// the system already exports the appropriate routine.

	#ifdef __cplusplus
	}
	#endif

#endif

static UInt32 AddAtomicCompat(UInt32 amount, UInt32 *value)
	// This routine is a standard "atomic add" function.
	// It has two purposes:
	// 1. It adapts AddAtomic to work with unsigned numbers.
	// 2. It binds to correct AddAtomic (DSL on modern machines,
	//    custom on pre-PCI machines).
	// 3. It uses the OTAtomicAdd on 68K, munging the result
	//	  to match the behaviour of AddAtomic.
{
	#if TARGET_CPU_68K
		// OTAtomicAdd32 is declared inline in "OpenTransport.h",
		// so you can use it regardless of whether OT is installed,
		// and without calling InitOpenTransport.
		return OTAtomicAdd32((SInt32) amount, (SInt32 *) value) - amount;
	#else
		#if TARGET_API_MAC_CARBON
			// Carbon alwasy has the DSL-style atomic add.
			return AddAtomic((SInt32) amount, (SInt32 *) value);
		#else
			// Non-Carbon may run on pre-PCI pre-8.5 systems, where we 
			// need to use our non-DSL add atomic.
			if ( false && AddAtomic == (void *) kUnresolvedCFragSymbolAddress) {
				return AddAtomicForNonDSL(amount, value);
			} else {
				return AddAtomic((SInt32) amount, (SInt32 *) value);
			}
		#endif
	#endif
}

/////////////////////////////////////////////////////////////////////

static void PlotChar(UInt8 thisChar, ByteCount thisCharIndex)
{
	UInt8 *charStart;
	ByteCount scanLine;
	ByteCount row;
	ByteCount col;
	UInt8 ch;
	ByteCount pixel;
	
	assert(thisCharIndex < kISDebugMaxCharIndex);

	row = thisCharIndex / kISDebugNumberOfColumns;	
	col = thisCharIndex % kISDebugNumberOfColumns;
	charStart = gScreenBase + row * gRowBytes * 10 + col * gBytesPerChar + kISDebugXPixelOffset + kISDebugYPixelOffset * gRowBytes;
	switch (gBytesPerChar) {
		case 1:
			for (scanLine = 0; scanLine < 10; scanLine++) {
				*charStart = gFont[scanLine][thisChar];
				charStart += gRowBytes;
			}
			break;
		case 4:
			for (scanLine = 0; scanLine < 10; scanLine++) {				
				ch = gFont[scanLine][thisChar];
				for (pixel = 0; pixel < 8; pixel++) {
					if (ch & 0x080) {
						charStart[pixel / 2] |= (pixel % 2) ? 0x0F : 0xF0;
					} else {
						charStart[pixel / 2] &= (pixel % 2) ? 0xF0 : 0x0F;
					}
					ch = ch << 1;
				}
				charStart += gRowBytes;
			}
			break;
		case 8:
			for (scanLine = 0; scanLine < 10; scanLine++) {
				ch = gFont[scanLine][thisChar];
				for (pixel = 0; pixel < 8; pixel++) {
					if (ch & 0x080) {
						charStart[pixel] = 0xFF;
					} else {
						charStart[pixel] = 0x00;
					}
					ch = ch << 1;
				}
				charStart += gRowBytes;
			}
			break;
		case 16:
			for (scanLine = 0; scanLine < 10; scanLine++) {
				ch = gFont[scanLine][thisChar];
				for (pixel = 0; pixel < 8; pixel++) {
					if (ch & 0x080) {
						((UInt16 *) charStart)[pixel] = 0x0000;
					} else {
						((UInt16 *) charStart)[pixel] = 0x7FFF;
					}
					ch = ch << 1;
				}
				charStart += gRowBytes;
			}
			break;
		case 32:
			for (scanLine = 0; scanLine < 10; scanLine++) {
				ch = gFont[scanLine][thisChar];
				for (pixel = 0; pixel < 8; pixel++) {
					if (ch & 0x080) {
						((UInt32 *) charStart)[pixel] = 0x00000000;
					} else {
						((UInt32 *) charStart)[pixel] = 0x00FFFFFF;
					}
					ch = ch << 1;
				}
				charStart += gRowBytes;
			}
			break;
		default:
			// do nothing
			break;
	}
}

extern void ISDebugChar(UInt8 ch)
	// See comment in interface part.
{
	ISDebugText(&ch, sizeof(ch));
}

extern void ISDebugText(const UInt8 *text, ByteCount len)
	// See comment in interface part.
{
	UInt32 lastCharIndex;

	// For interrupt-safeness, it's critical that this add be
	// atomic.
		
	lastCharIndex = AddAtomicCompat(len + 2, &gCurrentCharIndex) + len + 2;

	// Plotting this bullet is not 100% interrupt safe (we're assuming
	// that an interrupt hasn't come in between the AddAtomic and the plot
	// and written text which the bullet is going to overwrite) but it's
	// sufficiently useful in helping you find the last logged text
	// that I'm prepared to accept the uncertainty.
	
	PlotChar('¥', lastCharIndex % kISDebugMaxCharIndex);
	lastCharIndex -= 1;
	
	PlotChar('È', lastCharIndex % kISDebugMaxCharIndex);
	while (len != 0) {
		len -= 1;
		lastCharIndex -= 1;
		PlotChar(text[len], lastCharIndex % kISDebugMaxCharIndex);
	}
	lastCharIndex -= 1;
	PlotChar('Ç', lastCharIndex % kISDebugMaxCharIndex);
}

extern void ISDebugStr (ConstStr255Param str)
	// See comment in interface part.
{
	ISDebugText(&str[1], str[0]);
}

static ByteCount MyStrLen(const char * str)
	// Include my own strlen function because I want to avoid
	// linking with standard C libraries.
{
	ByteCount len = -1;
	do {
		len++;
	} while (*str++);	
	return(len);
}

extern void ISdebugstr (const char *str)
	// See comment in interface part.
{
	ISDebugText( (UInt8 *) str, MyStrLen(str));
}

/////////////////////////////////////////////////////////////////////

// In many cases, the black and white QuickDraw code 
// causes more trouble than it's worth (you get link 
// errors trying to access qd).  So, I've decided that 
// you have to set MORE_DEBUG_SUPPORT_BW if you want 
// black and white support.  Otherwise, we assume you have 
// have colour.

#if ! defined(MORE_DEBUG_SUPPORT_BW)
	#define MORE_DEBUG_SUPPORT_BW 0
#endif


static Boolean HasColourQuickDraw(void)
	// A standard test routine.  Note that you should
	// always test using the gestaltQuickdrawVersion, not
	// gestaltQuickdrawFeatures, because the latter
	// lies on a PB100 running System 7.0 or higher.
{
	UInt32 response;
	
	return Gestalt(gestaltQuickdrawVersion, (SInt32 *) &response) == noErr &&
			response >= gestaltOriginalQD;
}

extern OSStatus InitInterruptSafeDebug(void)
{
	OSStatus 	err;
	Rect 		bounds;
	Boolean		hasColourQD;

	err = noErr;
	
	#if MORE_DEBUG_SUPPORT_BW
		hasColourQD = HasColourQuickDraw();
	#else
		hasColourQD = true;
	#endif
	
	if ( hasColourQD ) {
		PixMapHandle mainDevPM;
	
		mainDevPM = (**GetMainDevice()).gdPMap;

		// PixelSize is in bits, multiply by 8 for the number of pixels
		// each character is across, divided by 8 to get bytes.

		gBytesPerChar = (**mainDevPM).pixelSize * 8 / 8;
		gScreenBase = (UInt8 *) GetPixBaseAddr(mainDevPM);
		gRowBytes = ((**mainDevPM).rowBytes) & 0x3FFF;		
		bounds = (**mainDevPM).bounds;
		
		// If we're running on a machine with 24 bit addressing
		// but the pixmap requires 32 bit addressing to access,
		// spit out an error.  I'm too lazy to handle this weird
		// case in my blitters.
		
		if ( GetMMUMode() == false32b && PixMap32Bit(mainDevPM) ) {
			err = unimpErr;
		}
	} else {
		#if MORE_DEBUG_SUPPORT_BW
			BitMap 		screenBits;
			
			gBytesPerChar = 1;
			(void) GetQDGlobalsScreenBits(&screenBits);
			gScreenBase = (UInt8 *) screenBits.baseAddr;
			gRowBytes = screenBits.rowBytes;
			bounds = screenBits.bounds;
		#else
			err = unimpErr;
		#endif
	}

	if ( (bounds.right - bounds.left) < kISDebugNumberOfColumns * 8 + kISDebugXPixelOffset ) {
		err = -1;
	}
	if ( (bounds.bottom - bounds.top) < kISDebugNumberOfRows   * 10 + kISDebugYPixelOffset ) {
		err = -2;
	}
	switch (gBytesPerChar) {
		case 1:
		case 4:
		case 8:
		case 16:
		case 32:
			break;
		default:
			// Everything else is left as an exercise for the reader.
			err = -3;
			break;
	}
			
	return err;
}
