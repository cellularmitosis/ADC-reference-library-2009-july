/**************************************************************
 *
 *	giantsstack.c
 *
 *	Updates:
 *		1  Feb 99   JAK - creation.
 *
 *  This package is part of ongoing research in the
 *	Advanced Computation Group, Apple Computer.
 *	
 *	c. 1999 Apple Computer, Inc.
 *	All Rights Reserved.
 *
 *
 *************************************************************/

/*
	Disclaimer:	IMPORTANT:  This Apple software is supplied to you by Apple Computer, Inc.
				("Apple") in consideration of your agreement to the following terms, and your
				use, installation, modification or redistribution of this Apple software
				constitutes acceptance of these terms.  If you do not agree with these terms,
				please do not use, install, modify or redistribute this Apple software.

				In consideration of your agreement to abide by the following terms, and subject
				to these terms, Apple grants you a personal, non-exclusive license, under AppleÕs
				copyrights in this original Apple software (the "Apple Software"), to use,
				reproduce, modify and redistribute the Apple Software, with or without
				modifications, in source and/or binary forms; provided that if you redistribute
				the Apple Software in its entirety and without modifications, you must retain
				this notice and the following text and disclaimers in all such redistributions of
				the Apple Software.  Neither the name, trademarks, service marks or logos of
				Apple Computer, Inc. may be used to endorse or promote products derived from the
				Apple Software without specific prior written permission from Apple.  Except as
				expressly stated in this notice, no other rights or licenses, express or implied,
				are granted by Apple herein, including but not limited to any patent rights that
				may be infringed by your derivative works or by other works in which the Apple
				Software may be incorporated.

				The Apple Software is provided by Apple on an "AS IS" basis.  APPLE MAKES NO
				WARRANTIES, EXPRESS OR IMPLIED, INCLUDING WITHOUT LIMITATION THE IMPLIED
				WARRANTIES OF NON-INFRINGEMENT, MERCHANTABILITY AND FITNESS FOR A PARTICULAR
				PURPOSE, REGARDING THE APPLE SOFTWARE OR ITS USE AND OPERATION ALONE OR IN
				COMBINATION WITH YOUR PRODUCTS.

				IN NO EVENT SHALL APPLE BE LIABLE FOR ANY SPECIAL, INDIRECT, INCIDENTAL OR
				CONSEQUENTIAL DAMAGES (INCLUDING, BUT NOT LIMITED TO, PROCUREMENT OF SUBSTITUTE
				GOODS OR SERVICES; LOSS OF USE, DATA, OR PROFITS; OR BUSINESS INTERRUPTION)
				ARISING IN ANY WAY OUT OF THE USE, REPRODUCTION, MODIFICATION AND/OR DISTRIBUTION
				OF THE APPLE SOFTWARE, HOWEVER CAUSED AND WHETHER UNDER THEORY OF CONTRACT, TORT
				(INCLUDING NEGLIGENCE), STRICT LIABILITY OR OTHERWISE, EVEN IF APPLE HAS BEEN
				ADVISED OF THE POSSIBILITY OF SUCH DAMAGE.
*/


#include "giantsstack.h"
#include "giantsdebug.h"

static Handle 			gGiantStackHandle = nil;

static unsigned long	gCurrentStackIndex=0;
static unsigned long	gStackSize=0;

#define STACK_INCREMENT_SIZE	100
#define max(a, b) (a > b ? a : b)

static Handle GetStackHandle()
{
	if (gGiantStackHandle == nil) {
		gGiantStackHandle = NewHandle(0);
		GAssert(gGiantStackHandle != nil);
	}
	
	return gGiantStackHandle;
}

static void AddGiants(unsigned long addcount)
{
	Handle		stackhandle = GetStackHandle();

	SetHandleSize( stackhandle, GetHandleSize(stackhandle) + (addcount*sizeof(giant)) );	
	GAssert(!MemError());
	
	gStackSize += addcount;
	
	while (addcount--) {
		(*(giant**)stackhandle)[gCurrentStackIndex] = newgiant(DEFAULT_GIANT_BITS);
		GAssert((*(giant**)stackhandle)[gCurrentStackIndex] != nil);
		gCurrentStackIndex++;
	}
	
	GAssert(!MemError());
}

giant	popg()
{
	Handle		stackhandle = GetStackHandle();
	giant		g;
	
	if (gCurrentStackIndex == 0) {
		AddGiants(STACK_INCREMENT_SIZE);
	}
	
	g = ((*(giant**)stackhandle)[--gCurrentStackIndex]);
	
	g->giantDigits = 0;
	
	ASSERT_GVALID(g);
	
	return g;
}

void	pushg(unsigned long numgiants)
{
	GAssert(gGiantStackHandle != nil);
	GAssert(gCurrentStackIndex + numgiants <= gStackSize);
	
	gCurrentStackIndex += numgiants;
}
