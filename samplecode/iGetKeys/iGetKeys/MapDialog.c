
/*
    File: iGetKeys.c
    
    Description:
       Internationally Savy GetKeys test type routines for your entertainment
       and enjoyment.

    Copyright:
        © Copyright 2001 Apple Computer, Inc. All rights reserved.
    
    Disclaimer:
        IMPORTANT:  This Apple software is supplied to you by Apple Computer, Inc.
        ("Apple") in consideration of your agreement to the following terms, and your
        use, installation, modification or redistribution of this Apple software
        constitutes acceptance of these terms.  If you do not agree with these terms,
        please do not use, install, modify or redistribute this Apple software.

        In consideration of your agreement to abide by the following terms, and subject
        to these terms, Apple grants you a personal, non-exclusive license, under AppleÍs
        copyrights in this original Apple software (the "Apple Software"), to use,
        reproduce, modify and redistribute the Apple Software, with or without
        modifications, in source and/or binary forms; provided that if you redistribute
        the Apple Software in its entirety and without modifications, you must retain
        this notice and the following text and disclaimers in all such redistributions of
        the Apple Software.  Neither the name, trademarks, service marks or logos of
        Apple Computer, Inc. may be used to endorse or promote products derived from the
        Apple Software without specific prior written permission from Apple.  Except as
        expressly stated in this notice, no other rights or licenses, express or implied,
        are granted by Apple herein, including but not limited to any patent rights that
        may be infringed by your derivative works or by other works in which the Apple
        Software may be incorporated.

        The Apple Software is provided by Apple on an "AS IS" basis.  APPLE MAKES NO
        WARRANTIES, EXPRESS OR IMPLIED, INCLUDING WITHOUT LIMITATION THE IMPLIED
        WARRANTIES OF NON-INFRINGEMENT, MERCHANTABILITY AND FITNESS FOR A PARTICULAR
        PURPOSE, REGARDING THE APPLE SOFTWARE OR ITS USE AND OPERATION ALONE OR IN
        COMBINATION WITH YOUR PRODUCTS.

        IN NO EVENT SHALL APPLE BE LIABLE FOR ANY SPECIAL, INDIRECT, INCIDENTAL OR
        CONSEQUENTIAL DAMAGES (INCLUDING, BUT NOT LIMITED TO, PROCUREMENT OF SUBSTITUTE
        GOODS OR SERVICES; LOSS OF USE, DATA, OR PROFITS; OR BUSINESS INTERRUPTION)
        ARISING IN ANY WAY OUT OF THE USE, REPRODUCTION, MODIFICATION AND/OR DISTRIBUTION
        OF THE APPLE SOFTWARE, HOWEVER CAUSED AND WHETHER UNDER THEORY OF CONTRACT, TORT
        (INCLUDING NEGLIGENCE), STRICT LIABILITY OR OTHERWISE, EVEN IF APPLE HAS BEEN
        ADVISED OF THE POSSIBILITY OF SUCH DAMAGE.

    Change History (most recent first):
        Mon, Jan 15, 2001 -- created
*/


#ifdef __APPLE_CC__
#include <Carbon/Carbon.h>
#else
#include <Carbon.h>
#include <stddef.h>
#endif
#include "MapDialog.h"






OSStatus NewDialogItemMap(DialogPtr theDialog, DialogMapRecPtr *theItems) {
	long i, n;
	DialogMapRecPtr items;
	DialogMapItem *itemip;
	OSStatus err;
	short itemt;
	Handle itemh;
		/* known state */
	items = NULL;
	SetPortWindowPort(GetDialogWindow(theDialog));
		/* allocate our list */
	n = CountDITL(theDialog);
	items = (DialogMapRecPtr) NewPtr(offsetof(DialogMapRecord, itemb) + sizeof(DialogMapItem) * n);
	if (items == NULL) { err = memFullErr; goto bail; }
		/* bounds */
	GetPortBounds(GetWindowPort(GetDialogWindow(theDialog)), &items->bounds);
		/* count */
	items->count = n;
		/* items */
	for (i=1, itemip = items->itemb; i<=n; itemip++, i++) {
		err = GetDialogItemAsControl( theDialog, i, &itemip->theItem);
		if (err != noErr) goto bail;
		GetControlBounds(itemip->theItem, &itemip->bounds);
		GetDialogItem( theDialog, i, &itemt, &itemh, &itemip->ibounds);
	}
		/* save result */
	*theItems = items;
	return noErr;
bail:
	if (items != NULL) DisposePtr((Ptr) items);
	return err;
}


void DeleteDialogItemMap(DialogMapRecPtr theItems) {
	DisposePtr((Ptr) theItems);
} 


OSStatus RemapDialog(DialogPtr theDialog, DialogMapRecPtr theItems) {
	long i;
	DialogMapItem *itemip;
	short itemt;
	Handle itemh;
	Rect newbounds, temp, theemptyrect = {0, 0, 0, 0};
	RgnHandle clipSave;
		/* set the port and get the map-to bounds */
	SetPortWindowPort(GetDialogWindow(theDialog));
	GetPortBounds(GetWindowPort(GetDialogWindow(theDialog)), &newbounds);
		/* turn off drawing until we're done shuffling items */
	GetClip((clipSave = NewRgn()));
	ClipRect(&theemptyrect);
		/* items */
	for (i=1, itemip = theItems->itemb; i <= theItems->count; itemip++, i++) {
			/* adjust control rectangle */
		temp = itemip->bounds;
		MapRect(&temp, &theItems->bounds, &newbounds);
		MoveControl(itemip->theItem, temp.left, temp.top);
		SizeControl(itemip->theItem, temp.right - temp.left, temp.bottom - temp.top);
			/* adjust item rectangle */
		GetDialogItem( theDialog, i, &itemt, &itemh, &temp);
		temp = itemip->ibounds;
		MapRect(&temp, &theItems->bounds, &newbounds);
		SetDialogItem( theDialog, i, itemt, itemh, &temp);
	}
		/* restore drawing */
	SetClip(clipSave);
	DisposeRgn(clipSave);
		/* clear the old contents */
	SetPortWindowPort(GetDialogWindow(theDialog));
	EraseRect(&newbounds);
	DrawDialog(theDialog);
	ValidWindowRect(GetDialogWindow(theDialog), &newbounds);
	//InvalWindowRect(GetDialogWindow(theDialog), &newbounds);
		/* done */
	return noErr;
}


void GrowMappedDialog(Point globalWhere, DialogPtr theDialog, DialogMapRecPtr theItems) {
	Rect sizerect;
	long grow_result;
	WindowPtr theWindow;
	theWindow = GetDialogWindow(theDialog);
	SetRect(&sizerect, theItems->bounds.right, theItems->bounds.bottom, 32767, 32767);
	grow_result = GrowWindow(theWindow, globalWhere, &sizerect);
	if (grow_result != 0) {
		SizeWindow(theWindow, LoWord(grow_result), HiWord(grow_result), true);
		RemapDialog(theDialog, theItems);
	}
}


