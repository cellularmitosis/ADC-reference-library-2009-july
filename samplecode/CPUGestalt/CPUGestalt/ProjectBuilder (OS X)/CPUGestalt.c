/*
	File:		CPUGestalt.c

	Contains:	This sample code illustrates the way to determine the 
				processor type of the Macintosh you're running on	
	

	Written by: DTS

	Copyright: 	© Copyright 2003 Apple Computer, Inc. All rights reserved.
	
	Disclaimer:	IMPORTANT:  This Apple software is supplied to you by Apple Computer, Inc.
				("Apple") in consideration of your agreement to the following terms, and your
				use, installation, modification or redistribution of this Apple software
				constitutes acceptance of these terms.  If you do not agree with these terms,
				please do not use, install, modify or redistribute this Apple software.

				In consideration of your agreement to abide by the following terms, and subject
				to these terms, Apple grants you a personal, non-exclusive license, under AppleÕs
				copyrights in this original Apple software (the "Apple Software"), to use,
				reproduce, modify and redistribute the Apple Software, with or without
				modifications, in source and/or binary forms; provided that if you redistribute
				the Apple Software in its entirety and without modifications, you must retain
				this notice and the following text and disclaimers in all such redistributions of
				the Apple Software.  Neither the name, trademarks, service marks or logos of
				Apple Computer, Inc. may be used to endorse or promote products derived from the
				Apple Software without specific prior written permission from Apple.  Except as
				expressly stated in this notice, no other rights or licenses, express or implied,
				are granted by Apple herein, including but not limited to any patent rights that
				may be infringed by your derivative works or by other works in which the Apple
				Software may be incorporated.

				The Apple Software is provided by Apple on an "AS IS" basis.  APPLE MAKES NO
				WARRANTIES, EXPRESS OR IMPLIED, INCLUDING WITHOUT LIMITATION THE IMPLIED
				WARRANTIES OF NON-INFRINGEMENT, MERCHANTABILITY AND FITNESS FOR A PARTICULAR
				PURPOSE, REGARDING THE APPLE SOFTWARE OR ITS USE AND OPERATION ALONE OR IN
				COMBINATION WITH YOUR PRODUCTS.

				IN NO EVENT SHALL APPLE BE LIABLE FOR ANY SPECIAL, INDIRECT, INCIDENTAL OR
				CONSEQUENTIAL DAMAGES (INCLUDING, BUT NOT LIMITED TO, PROCUREMENT OF SUBSTITUTE
				GOODS OR SERVICES; LOSS OF USE, DATA, OR PROFITS; OR BUSINESS INTERRUPTION)
				ARISING IN ANY WAY OUT OF THE USE, REPRODUCTION, MODIFICATION AND/OR DISTRIBUTION
				OF THE APPLE SOFTWARE, HOWEVER CAUSED AND WHETHER UNDER THEORY OF CONTRACT, TORT
				(INCLUDING NEGLIGENCE), STRICT LIABILITY OR OTHERWISE, EVEN IF APPLE HAS BEEN
				ADVISED OF THE POSSIBILITY OF SUCH DAMAGE.

	Change History (most recent first):
                7/21/2003	MK				Updated for Project Builder
                7/23/1999	KG				Updated for Metrowerks Codewarror Pro 2.1 and
											Added PowerPC 750 processor
				

*/

//%
#include <Carbon/Carbon.h>
//#include <Gestalt.h>
//%
#include <stdio.h>

//%
//void main()
int main()
//%
{
	OSErr	err;
	long	getCPUtype;
		
	// check to see if we're on a Power Macintosh
	err = Gestalt (gestaltNativeCPUtype, &getCPUtype);
	
	if (0x100 & getCPUtype) {
		// we are on a Power Macintosh
		if (getCPUtype == gestaltCPU601)
			printf( "\nThis is a Power Macintosh with a 601 processor." );
		else if (getCPUtype == gestaltCPU603)
			printf( "\nThis is a Power Macintosh with a 603 processor." );
		else if (getCPUtype == gestaltCPU604)
			printf( "\nThis is a Power Macintosh with a 604 processor." );
		else if (getCPUtype==gestaltCPU750)
			printf( "\nThis is a Power Macintosh with a 750(G3) processor." );
        //%
        else if (getCPUtype==gestaltCPUG4)
			printf( "\nThis is a Power Macintosh with a G4 processor." );
        //%
		else
			printf( "\nThis is a Power Macintosh with a processor that I am unaware of." );
	} else {
		// we are on a 68K Macintosh
		err = Gestalt ( gestaltProcessorType, &getCPUtype );
		if (getCPUtype == gestalt68040)
			printf( "\nThis is a 68K Macintosh with a 68040 processor." );
		else if (getCPUtype == gestalt68030)
			printf( "\nThis is a 68K Macintosh with a 68030 processor." );
		else if (getCPUtype == gestalt68020)
			printf( "\nThis is a 68K Macintosh with a 68020 processor." );
		else if (getCPUtype == gestalt68010)
			printf( "\nThis is a 68K Macintosh with a 68010 processor." );
		else if (getCPUtype == gestalt68000)
			printf( "\nThis is a 68K Macintosh with a 68000 processor." );
		else
			printf( "\nThis is a 68K Macintosh with a processor that I am unaware of." );
	}
    
    //%
    return 0;
    //%
}
