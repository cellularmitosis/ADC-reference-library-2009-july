

/*
	File:		FinderCommentWindow.c
	
	Description:
	routines for managing the finder comment windows.

	Author:		JM

	Copyright: 	Copyright (c) 2003 Apple Computer, Inc. All rights reserved.
	
	Disclaimer:	IMPORTANT:  This Apple software is supplied to you by Apple Computer, Inc.
				("Apple") in consideration of your agreement to the following terms, and your
				use, installation, modification or redistribution of this Apple software
				constitutes acceptance of these terms.  If you do not agree with these terms,
				please do not use, install, modify or redistribute this Apple software.

				In consideration of your agreement to abide by the following terms, and subject
				to these terms, Apple grants you a personal, non-exclusive license, under AppleÕs
				copyrights in this original Apple software (the "Apple Software"), to use,
				reproduce, modify and redistribute the Apple Software, with or without
				modifications, in source and/or binary forms; provided that if you redistribute
				the Apple Software in its entirety and without modifications, you must retain
				this notice and the following text and disclaimers in all such redistributions of
				the Apple Software.  Neither the name, trademarks, service marks or logos of
				Apple Computer, Inc. may be used to endorse or promote products derived from the
				Apple Software without specific prior written permission from Apple.  Except as
				expressly stated in this notice, no other rights or licenses, express or implied,
				are granted by Apple herein, including but not limited to any patent rights that
				may be infringed by your derivative works or by other works in which the Apple
				Software may be incorporated.

				The Apple Software is provided by Apple on an "AS IS" basis.  APPLE MAKES NO
				WARRANTIES, EXPRESS OR IMPLIED, INCLUDING WITHOUT LIMITATION THE IMPLIED
				WARRANTIES OF NON-INFRINGEMENT, MERCHANTABILITY AND FITNESS FOR A PARTICULAR
				PURPOSE, REGARDING THE APPLE SOFTWARE OR ITS USE AND OPERATION ALONE OR IN
				COMBINATION WITH YOUR PRODUCTS.

				IN NO EVENT SHALL APPLE BE LIABLE FOR ANY SPECIAL, INDIRECT, INCIDENTAL OR
				CONSEQUENTIAL DAMAGES (INCLUDING, BUT NOT LIMITED TO, PROCUREMENT OF SUBSTITUTE
				GOODS OR SERVICES; LOSS OF USE, DATA, OR PROFITS; OR BUSINESS INTERRUPTION)
				ARISING IN ANY WAY OUT OF THE USE, REPRODUCTION, MODIFICATION AND/OR DISTRIBUTION
				OF THE APPLE SOFTWARE, HOWEVER CAUSED AND WHETHER UNDER THEORY OF CONTRACT, TORT
				(INCLUDING NEGLIGENCE), STRICT LIABILITY OR OTHERWISE, EVEN IF APPLE HAS BEEN
				ADVISED OF THE POSSIBILITY OF SUCH DAMAGE.
				
	Change History (most recent first):
        Fri, Aug 29, 2000 -- created
*/

#include "FinderCommentWindow.h"
#include "MyScriptsGlue.h"


	/* FinderCommentEventHandler is a carbon event handler we install on our
	Finder Comment windows to handle close events sent to the window.  Essentially,
	this routine cleans up the alias handle we stored in the window's refcon
	field and disposes of the window. */
static pascal OSStatus FinderCommentEventHandler(EventHandlerCallRef inHandlerCallRef, EventRef inEvent, void *inUserData) {
	OSStatus err, returnedResult;
	UInt32 eclass, ekind;
		/* set up locals */
	eclass = GetEventClass(inEvent);
	ekind = GetEventKind(inEvent);
		/* default result */
	returnedResult = eventNotHandledErr;
		/* dispatch the event */
	if (eclass == kEventClassWindow && ekind == kEventWindowClose) {
		AliasHandle theFileAlias;
		WindowRef window;
		
			/* we stored a reference to the window in the this
			carbon event handlers user data parameter.  let's
			go get that... it's a reference to the finder comment
			window we are closing.  */
		window = (WindowRef) inUserData;

			/* we stored an alias referencing the file in the
			window's refcon field.  let's go get that... */
		theFileAlias = (AliasHandle) GetWRefCon(window);
		
			/* release our alias handle */ 
		DisposeHandle((Handle) theFileAlias);
		
			/* delete the window */ 
		DisposeWindow( window );
		
			/* we're done! */ 
		returnedResult = noErr;
		
	} else if ( eclass == kEventClassCommand && ekind == kEventProcessCommand ) {
		HICommandExtended command;
		err = GetEventParameter( inEvent, kEventParamDirectObject,
								typeHICommand, NULL, sizeof(command), NULL, &command);
		if (err == noErr) {
			switch ( command.commandID ) {
			
				case 'SCOM': /* the 'save finder comment' button in the finder comment window */
						/* save finder comment */
					{	WindowRef window;
						ControlID controlID = { 'COMN', 0};
						ControlRef control;
						CFStringRef theNewComment;
							
							/* we stored a reference to the window in the this
							carbon event handlers user data parameter.  let's
							go get that... it's a reference to the finder comment
							window.  */
						window = (WindowRef) inUserData;
						
							/* get the contents of the comment text field */
						err = GetControlByID( window, &controlID, &control );
						if ( noErr == err ) {
						
								/* get the text out of the text field */
							err = GetControlData( control, kControlEntireControl,
											kControlEditTextCFStringTag, sizeof(theNewComment),
											&theNewComment, NULL);
							if ( noErr == err ) {
								AliasHandle theFileAlias;
								
									/* we stored an alias referencing the file in the
									window's refcon field.  let's go get that... */
								theFileAlias = (AliasHandle) GetWRefCon(window);
								
									/* call the script to set the Finder comment to the new text */
								err = script_setfilecomment(theFileAlias, theNewComment);
								if ( noErr != err ) {
									CFStringRef message;
									
										/* if an error occured, then we'll call the display message script
										to display the error message. First, we try to contstruct a message
										containing the error code.  */
									message = CFStringCreateWithFormat(NULL, NULL,
										CFSTR("An error %d prevented the comment from being set."), err);
									if ( NULL != message ) {
									
											/* if we were able to construct a message, then we use that */
										script_displaymessage(CFSTR("An error prevented the comment from being set."));
										
											/* done with the message */
										CFRelease(message);
									} else {
									
											/* otherwise we display a generic type message */
										script_displaymessage(CFSTR("An error prevented the comment from being set."));
									}
								} else {
									EventRef theCloseEvent;
									
										/* After saving the new comment in the file we will close
										the window.  To do that, we send a carbon event to our window
										asking it to close itself. First, we construct the event...*/
									err = CreateEvent( NULL, kEventClassWindow, kEventWindowClose,
										kEventDurationNoWait, kEventAttributeNone, &theCloseEvent);
									if ( noErr == err ) {
									
											/* then we send the event */
										SendEventToEventTarget(theCloseEvent, GetWindowEventTarget( window ));
										
											/* done with the event */
										ReleaseEvent(theCloseEvent);
									}
								}
									/* done with the new comment text that we extracted from
									the comment text field in the finder comment window. */
								CFRelease(theNewComment);
							}
						}
					}
						/* we handled the event */
					returnedResult = noErr;
					break;


				case 'SWFL': /* the 'show file' button in the finder comment window. */
					{	WindowRef window;
						AliasHandle theFileAlias;
						
							/* we stored a reference to the window in the this
							carbon event handlers user data parameter.  let's
							go get that... it's a reference to the finder comment
							window.  */
						window = (WindowRef) inUserData;
						
							/* we stored an alias referencing the file in the
							window's refcon field.  let's go get that... */
						theFileAlias = (AliasHandle) GetWRefCon(window);
						
							/* call the script to display the file */
						err = script_displayfile( theFileAlias );
							
					}
						/* we handled the event */
					returnedResult = noErr;
					break;
				
			}
		}
	}
	return returnedResult;
}



	/* OpenFinderCommentWindow opens a new window that displays
	the finder comment and allows us to edit and change the finder
	comment.  */
OSStatus OpenFinderCommentWindow(AliasHandle theItem) {
	CFStringRef theFileComment;
	OSStatus err;
	
		/* call the script to retrieve the finder comment for
		the item referenced by the alias parameter. */
	err = script_getfilecomment(theItem, &theFileComment);
	if ( noErr == err ) {
		IBNibRef nibRef;
		
			/* get a reference to the main nib file */
		err = CreateNibReference(CFSTR("main"), &nibRef);
		if ( noErr == err ) {
			WindowRef window;
			
				/* create a new finder comment window to display
				the finder comment. */
			err = CreateWindowFromNib(nibRef, CFSTR("FinderComment"), &window);
			if ( noErr == err ) {
				ControlID comControlID = { 'COMN', 0};
				ControlID fsControlID = { 'FSTR', 0};
				ControlRef control, fsControl;
				CFStringRef fileString;
				AliasHandle localAlias;
				
					/* make a copy of the alias that we can store
					in our persistent state information for this window. */
				localAlias = theItem;
				err = HandToHand((Handle*) &localAlias);
				if ( noErr != err ) {
					localAlias = NULL;
				}
				
					/* set the comment text */
				if ( noErr == err ) {
				
						/* retrieve the comment text field control */
					err = GetControlByID( window, &comControlID, &control );
					if ( noErr == err ) {
					
							/* store the comment text in the control */
						err = SetControlData( control, kControlEntireControl,
							kControlEditTextCFStringTag, sizeof(theFileComment),
							&theFileComment);				
					}
				}
				
					/* set the title string */
				if ( noErr == err ) {
				
						/* call the script to convert our file reference into a
						string for display at the top of the window. */
					err = script_filetostring(theItem, &fileString);
					if ( noErr == err ) {
					
							/* retrieve the static text control we are using
							to display the string. */
						err = GetControlByID( window, &fsControlID, &fsControl );
						if ( noErr == err ) {
						
								/* store the string data in the control */
							err = SetControlData( fsControl, kControlEntireControl,
								kControlStaticTextCFStringTag, sizeof(fileString),
								&fileString);				
						}
							/* done with the file name string. */
						CFRelease(fileString);
					}
				}
				
					/* install our window's close handler */
				if ( noErr == err ) {
					EventTypeSpec finderCommentWindowEvents[] = {
									{ kEventClassWindow, kEventWindowClose },
									{ kEventClassCommand, kEventProcessCommand } };
					
							/* Install a carbon event handler on our finder comment window.
							put a reference to our window in the userdata field so we
							can get at it in the close handler. */
					err	= InstallEventHandler( GetWindowEventTarget( window ),
							NewEventHandlerUPP(FinderCommentEventHandler),
							(sizeof(finderCommentWindowEvents)/sizeof(EventTypeSpec)),
							finderCommentWindowEvents, window, NULL);
				}
				
					/* store the alias we created in the window's refcon
					field so we can get at it in our various handlers when
					we need to access the file. */
				if ( noErr == err ) {
					SetWRefCon(window, (long) localAlias);
				}
					/* display the window */
				if ( noErr == err ) {
					ShowWindow(window);
				} else {
					DisposeWindow(window);
					if ( NULL != localAlias ) DisposeHandle((Handle) localAlias);
				}
			}
			DisposeNibReference(nibRef);
		}
		CFRelease(theFileComment);
	}
	return err;
}

