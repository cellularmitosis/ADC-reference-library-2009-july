/*
	File:		DataBrowserTab.c
	
	Contains:	Contains routines responsible for some common DataBrowser opperations including
				displaying colorized text, cell selection and moving columns.

	Disclaimer:	IMPORTANT:  This Apple software is supplied to you by Apple Computer, Inc.
				("Apple") in consideration of your agreement to the following terms, and your
				use, installation, modification or redistribution of this Apple software
				constitutes acceptance of these terms.  If you do not agree with these terms,
				please do not use, install, modify or redistribute this Apple software.

				In consideration of your agreement to abide by the following terms, and subject
				to these terms, Apple grants you a personal, non-exclusive license, under AppleÕs
				copyrights in this original Apple software (the "Apple Software"), to use,
				reproduce, modify and redistribute the Apple Software, with or without
				modifications, in source and/or binary forms; provided that if you redistribute
				the Apple Software in its entirety and without modifications, you must retain
				this notice and the following text and disclaimers in all such redistributions of
				the Apple Software.  Neither the name, trademarks, service marks or logos of
				Apple Computer, Inc. may be used to endorse or promote products derived from the
				Apple Software without specific prior written permission from Apple.  Except as
				expressly stated in this notice, no other rights or licenses, express or implied,
				are granted by Apple herein, including but not limited to any patent rights that
				may be infringed by your derivative works or by other works in which the Apple
				Software may be incorporated.

				The Apple Software is provided by Apple on an "AS IS" basis.  APPLE MAKES NO
				WARRANTIES, EXPRESS OR IMPLIED, INCLUDING WITHOUT LIMITATION THE IMPLIED
				WARRANTIES OF NON-INFRINGEMENT, MERCHANTABILITY AND FITNESS FOR A PARTICULAR
				PURPOSE, REGARDING THE APPLE SOFTWARE OR ITS USE AND OPERATION ALONE OR IN
				COMBINATION WITH YOUR PRODUCTS.

				IN NO EVENT SHALL APPLE BE LIABLE FOR ANY SPECIAL, INDIRECT, INCIDENTAL OR
				CONSEQUENTIAL DAMAGES (INCLUDING, BUT NOT LIMITED TO, PROCUREMENT OF SUBSTITUTE
				GOODS OR SERVICES; LOSS OF USE, DATA, OR PROFITS; OR BUSINESS INTERRUPTION)
				ARISING IN ANY WAY OUT OF THE USE, REPRODUCTION, MODIFICATION AND/OR DISTRIBUTION
				OF THE APPLE SOFTWARE, HOWEVER CAUSED AND WHETHER UNDER THEORY OF CONTRACT, TORT
				(INCLUDING NEGLIGENCE), STRICT LIABILITY OR OTHERWISE, EVEN IF APPLE HAS BEEN
				ADVISED OF THE POSSIBILITY OF SUCH DAMAGE.

	Copyright © 2001 Apple Computer, Inc., All Rights Reserved
*/


#ifdef __APPLE_CC__
#include <Carbon/Carbon.h>
#else
#include <Carbon.h>
#endif

#include	"Main.h"


static pascal void DBCustomDrawProc( ControlRef browser, DataBrowserItemID item, DataBrowserPropertyID property, DataBrowserItemState itemState, const Rect *theRect, SInt16 gdDepth, Boolean colorDevice);



void	CreateMyDataBrowserControl( WindowRef window )
{
	const	ControlID			dbControlID			= { 'Brow', 0 };
	OSStatus					err;
	ControlRef					dbControl;
	DataBrowserCustomCallbacks	dbCustomCallbacks;
	DataBrowserItemID			dataBrowserItemID	= 1;						//	This will be our "row" ID
	
	GetControlByID( window, &dbControlID, &dbControl );
	
	dbCustomCallbacks.version					= kDataBrowserLatestCallbacks;
 	InitDataBrowserCustomCallbacks( &dbCustomCallbacks );
	dbCustomCallbacks.u.v1.drawItemCallback		= NewDataBrowserDrawItemUPP( DBCustomDrawProc );	//	Need a custom draw proc for colored text
	SetDataBrowserCustomCallbacks( dbControl, &dbCustomCallbacks );
	
	err	= AddDataBrowserItems( dbControl, kDataBrowserNoItem, 1, &dataBrowserItemID, kDataBrowserItemNoProperty );		//	Create row "1"
	dataBrowserItemID++;
	err	= AddDataBrowserItems( dbControl, kDataBrowserNoItem, 1, &dataBrowserItemID, kDataBrowserItemNoProperty );		//	Create row "2"
	
	SetDataBrowserSelectionFlags( dbControl, kDataBrowserCmdTogglesSelection );
	
	SetAutomaticControlDragTrackingEnabledForWindow( window, true );			//	Needed to automatically support moving columns
	
	return;
}

static pascal void DBCustomDrawProc( ControlRef browser, DataBrowserItemID item, DataBrowserPropertyID property, DataBrowserItemState itemState, const Rect *theRect, SInt16 gdDepth, Boolean colorDevice)
{
	RGBColor			color;
	CFStringRef			cfString;
	long				systemVersion;

	cfString	= CFStringCreateWithFormat( NULL, NULL, CFSTR("Row %d"), item );
	
	if ( itemState == kDataBrowserItemIsSelected )			//	In this sample we handle the "selected" state, all others fall through to our "active" state
	{
		Gestalt( gestaltSystemVersion, &systemVersion );
		if ( (systemVersion >= 0x00001030) && (IsControlActive( browser ) == false) )	//	Panther DB starts using kThemeBrushSecondaryHighlightColor for inactive browser hilighting
			SetThemePen( kThemeBrushSecondaryHighlightColor, 32, true );
		else
			SetThemePen( kThemeBrushPrimaryHighlightColor, 32, true );

		PaintRect( theRect );								//	First paint the hilite rect, then the text on top
	}

	BlockZero( &color, sizeof(color) );						//	set the color for our text
	if ( property == 'Red ' )		color.red	= 0xFFFF;
	else if ( property == 'Blue' )	color.blue	= 0xFFFF;
	else							color.green	= 0xFFFF;

#if ( (0) && (__APPLE_CC__) )	//	This section shows how to draw colored text using CG.  (Available directly through Mach-O, hence the __APPLE_CC__ for this sample)
	{
		CGContextRef		cgContext;
		GrafPtr				port;
		GetPort( &port );
		QDBeginCGContext( port, &cgContext );
		CGContextSetRGBFillColor( cgContext, (float)color.red / (float)65535, (float)color.green / (float)65535, (float)color.blue / (float)65535, 1.0 );
		DrawThemeTextBox( cfString, kThemeWindowTitleFont, kThemeStateActive, true, theRect, teFlushDefault, cgContext );
		QDEndCGContext( port, &cgContext );
	}
#else
	{
	RGBColor			oColor;
		GetForeColor( &oColor );
		RGBForeColor( &color );
		DrawThemeTextBox( cfString, kThemeApplicationFont, kThemeStateActive, true, theRect, teFlushDefault, NULL );	//	Draw anti-aliased colored text
		RGBForeColor( &oColor );
	}
#endif
	if ( cfString != NULL )	CFRelease( cfString );
}

