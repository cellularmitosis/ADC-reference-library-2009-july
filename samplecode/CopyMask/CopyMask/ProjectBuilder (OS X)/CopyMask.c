/*
	File:		CopyMask.c

	Contains:	Shows how CopyMask can used to fade a screen to a lighter color.	

	Written by: JW

	Copyright:	Copyright © 1999 by Apple Computer, Inc., All Rights Reserved.

	Disclaimer:	IMPORTANT:  This Apple software is supplied to you by Apple Computer, Inc.
				("Apple") in consideration of your agreement to the following terms, and your
				use, installation, modification or redistribution of this Apple software
				constitutes acceptance of these terms.  If you do not agree with these terms,
				please do not use, install, modify or redistribute this Apple software.

				In consideration of your agreement to abide by the following terms, and subject
				to these terms, Apple grants you a personal, non-exclusive license, under AppleÕs
				copyrights in this original Apple software (the "Apple Software"), to use,
				reproduce, modify and redistribute the Apple Software, with or without
				modifications, in source and/or binary forms; provided that if you redistribute
				the Apple Software in its entirety and without modifications, you must retain
				this notice and the following text and disclaimers in all such redistributions of
				the Apple Software.  Neither the name, trademarks, service marks or logos of
				Apple Computer, Inc. may be used to endorse or promote products derived from the
				Apple Software without specific prior written permission from Apple.  Except as
				expressly stated in this notice, no other rights or licenses, express or implied,
				are granted by Apple herein, including but not limited to any patent rights that
				may be infringed by your derivative works or by other works in which the Apple
				Software may be incorporated.

				The Apple Software is provided by Apple on an "AS IS" basis.  APPLE MAKES NO
				WARRANTIES, EXPRESS OR IMPLIED, INCLUDING WITHOUT LIMITATION THE IMPLIED
				WARRANTIES OF NON-INFRINGEMENT, MERCHANTABILITY AND FITNESS FOR A PARTICULAR
				PURPOSE, REGARDING THE APPLE SOFTWARE OR ITS USE AND OPERATION ALONE OR IN
				COMBINATION WITH YOUR PRODUCTS.

				IN NO EVENT SHALL APPLE BE LIABLE FOR ANY SPECIAL, INDIRECT, INCIDENTAL OR
				CONSEQUENTIAL DAMAGES (INCLUDING, BUT NOT LIMITED TO, PROCUREMENT OF SUBSTITUTE
				GOODS OR SERVICES; LOSS OF USE, DATA, OR PROFITS; OR BUSINESS INTERRUPTION)
				ARISING IN ANY WAY OUT OF THE USE, REPRODUCTION, MODIFICATION AND/OR DISTRIBUTION
				OF THE APPLE SOFTWARE, HOWEVER CAUSED AND WHETHER UNDER THEORY OF CONTRACT, TORT
				(INCLUDING NEGLIGENCE), STRICT LIABILITY OR OTHERWISE, EVEN IF APPLE HAS BEEN
				ADVISED OF THE POSSIBILITY OF SUCH DAMAGE.

	Change History (most recent first):
        6/2003		MK				Updated for ProjectBuilder
        
        08/2000		JM				Carbonized, non-Carbon code is commented out
                                    for demonstration purposes.
                                                        
        7/9/1999	KG				Updated for Metrowerks Codewarror Pro 2.1
				

*/
#include	"CarbonPrefix.h"

int main()
{
	WindowPtr		mainWinPtr;
	OSErr			error;
	//SysEnvRec		theWorld;	//not available in carbon
	long			result;		//used in carbonization
	GWorldPtr		myOffscreen1, myOffscreen2;
	GDHandle		oldDevice;
	CGrafPtr		oldPort;
	Rect			windRect, offRect, myRect;
	RGBColor		theColor;
	int				i;
	RgnHandle		rgnHandle = NewRgn();
	
	/* Make sure ColorQD exists. */
	/*error = SysEnvirons(1, &theWorld);
	if (theWorld.hasColorQD == false) {
		SysBeep(50);
		ExitToShell();
	}*/
	
	error = Gestalt(gestaltQuickdrawVersion, &result);
	if (error != noErr || result < gestalt8BitQD) {
		SysBeep(50);
		ExitToShell();
	}
	
	/* Initialize all the needed managers. */
	/*InitGraf(&qd.thePort);
	InitFonts();
	InitWindows();
	InitMenus();
	TEInit();
	InitDialogs(nil);*/
	InitCursor();

	/* Define output window. */
	SetRect(&windRect, 100, 100, 400, 400);
	SetRect(&offRect, 0, 0, 300, 300);
	mainWinPtr = NewCWindow(nil, &windRect, "\pJohn", true, documentProc, (WindowPtr) -1, false, 0);
	//SetPort(mainWinPtr);
	SetPortWindowPort(mainWinPtr);
	GetGWorld(&oldPort, &oldDevice);

	/* Create two offscreen GWorlds. */
	if (NewGWorld(&myOffscreen1, 0, &offRect, nil, nil, 0))
		Debugger();
	if (NewGWorld(&myOffscreen2, 0, &offRect, nil, nil, 0))
		Debugger();
	
	/* Now, draw ramp to first offscreen pixmap. */
	SetGWorld(myOffscreen1, nil);
	for (i=0; i<10; i++) {
		theColor.red = theColor.green = theColor.blue = (i*28) << 8;
		RGBForeColor(&theColor);
		SetRect(&myRect, 0, i*30, 300, i*30+30);
		PaintRect(&myRect);
	}

	/* Now, draw mask to second offscreen pixmap. */
	SetGWorld(myOffscreen2, nil);
	SetRect(&myRect, 0, 0, 300, 300);
	theColor.red = theColor.green = theColor.blue = (128) << 8;
	RGBForeColor(&theColor);
	PaintRect(&myRect);

	/*	Draw to the ramp to the window.	*/
	SetGWorld(oldPort, oldDevice);
	/*CopyBits((BitMapPtr) *myOffscreen1->portPixMap, &(*mainWinPtr).portBits, &offRect,
				&offRect, 0, nil);*/
	CopyBits((BitMapPtr) *(GetPortPixMap(myOffscreen1)), GetPortBitMapForCopyBits(GetWindowPort(mainWinPtr)), &offRect,
				&offRect, 0, nil);
	QDFlushPortBuffer(GetWindowPort(mainWinPtr), GetPortVisibleRegion(GetWindowPort(mainWinPtr), rgnHandle));

	/* Wait until user clicks button. */
	do {
	} while (!Button());
	
	/*	Now fade the window to white using CopyMask.  The destination must be erased
		for CopyMask to work.	*/
	SetGWorld(oldPort, oldDevice);
	EraseRect(&offRect);
	/*CopyMask((BitMapPtr) *myOffscreen1->portPixMap, (BitMapPtr) *myOffscreen2->portPixMap,
				&(*mainWinPtr).portBits, &offRect, &offRect, &offRect);*/
	CopyMask((BitMapPtr) *(GetPortPixMap(myOffscreen1)), (BitMapPtr) *(GetPortPixMap(myOffscreen2)),
				GetPortBitMapForCopyBits(GetWindowPort(mainWinPtr)), &offRect, &offRect, &offRect);
	QDFlushPortBuffer(GetWindowPort(mainWinPtr), GetPortVisibleRegion(GetWindowPort(mainWinPtr), rgnHandle));

	/* Wait until user clicks button. */
	do {
	} while (Button());
	do {
	} while (!Button());
	
	DisposeRgn(rgnHandle);
        
        return 0;
}
